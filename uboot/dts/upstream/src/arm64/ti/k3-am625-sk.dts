// SPDX-License-Identifier: GPL-2.0-only OR MIT
/*
 * AM625 SK: https://www.ti.com/lit/zip/sprr448
 *
 * Copyright (C) 2021-2024 Texas Instruments Incorporated - https://www.ti.com/
 */

/dts-v1/;

#include "k3-am625.dtsi"
#include "k3-am625-sk-common.dtsi"

/ {
	compatible = "ti,am625-sk", "ti,am625";
	model = "Texas Instruments AM625 SK";

	memory@80000000 {
		/* 2G RAM */
		reg = <0x00000000 0x80000000 0x00000000 0x80000000>;
		device_type = "memory";
		bootph-pre-ram;
	};
};


&reserved_memory {
	shmem_obc_sysflag: shmem_obc_sysflag@98000000 {
		compatible = "shmem_ems";
		reg = <0x0 0x98000000 0x0 0x400000>; /* 4MB */
		no-map; /* 关键！告诉内核不要为这块内存建立虚拟映射 */
	};
};
